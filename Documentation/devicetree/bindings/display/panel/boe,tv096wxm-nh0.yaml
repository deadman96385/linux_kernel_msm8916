## Documentation/devicetree/bindings/display/panel/boe,tv096wxm-nh0.yaml
```yaml
# SPDX-License-Identifier: (GPL-2.0-only OR BSD-2-Clause)
%YAML 1.2
---
$id: http://devicetree.org/schemas/display/panel/boe,tv096wxm-nh0.yaml#
$schema: http://devicetree.org/meta-schemas/core.yaml#

title: BOE TV096WXM-NH0 DSI Display Panel

maintainers:
  - postmarketOS Kernel maintainers <kernel@postmarketos.org>

description:
  The TV096WXM-NH0 is a 9.6-inch 800x1280 TFT LCD panel with an
  integrated Novatek NT51017 controller and a four-lane MIPI DSI interface.

allOf:
  - $ref: panel-common.yaml#

properties:
  compatible:
    const: boe,tv096wxm-nh0

  reg:
    maxItems: 1

  backlight: true

  vdd-supply:
    description: 3.3 V panel supply

  vsp-supply:
    description: Positive panel bias supply

  vsn-supply:
    description: Negative panel bias supply

  port: true

required:
  - compatible
  - reg
  - backlight
  - vdd-supply
  - vsp-supply
  - vsn-supply

additionalProperties: false

examples:
  - |
    dsi {
        #address-cells = <1>;
        #size-cells = <0>;

        panel@0 {
            compatible = "boe,tv096wxm-nh0";
            reg = <0>;

            backlight = <&backlight>;
            vdd-supply = <&panel_vdd>;
            vsp-supply = <&panel_vsp>;
            vsn-supply = <&panel_vsn>;

            port {
                panel_in: endpoint {
                    remote-endpoint = <&dsi_out>;
                };
            };
        };
    };
...
```

## Documentation/devicetree/bindings/display/panel/samsung,s6e8aa5x01-ams497hy01.yaml
```yaml
# SPDX-License-Identifier: (GPL-2.0-only OR BSD-2-Clause)
%YAML 1.2
---
$id: http://devicetree.org/schemas/display/panel/samsung,s6e8aa5x01-ams497hy01.yaml#
$schema: http://devicetree.org/meta-schemas/core.yaml#

title: Samsung AMS497HY01 and AMS520KT01 AMOLED panels

maintainers:
  - Sean Hoyt <seanhoyt963@gmail.com>

description: |
  The Samsung AMS497HY01 and AMS520KT01 are 720x1280 AMOLED panels with an
  S6E8AA5X01 display controller. They use a four-lane MIPI-DSI video link and
  require separate core and analog supplies.

allOf:
  - $ref: panel-common.yaml#

properties:
  compatible:
    enum:
      - samsung,s6e8aa5x01-ams497hy01
      - samsung,s6e8aa5x01-ams520kt01

  reg:
    maxItems: 1

  vdd3-supply:
    description: Core voltage supply

  vci-supply:
    description: Analog circuit voltage supply

  reset-gpios: true

  port: true

required:
  - compatible
  - reg
  - vdd3-supply
  - vci-supply
  - reset-gpios

additionalProperties: false

examples:
  - |
    #include <dt-bindings/gpio/gpio.h>

    dsi {
        #address-cells = <1>;
        #size-cells = <0>;

        panel@0 {
            compatible = "samsung,s6e8aa5x01-ams497hy01";
            reg = <0>;

            vdd3-supply = <&panel_vdd3>;
            vci-supply = <&panel_vci>;
            reset-gpios = <&tlmm 25 GPIO_ACTIVE_LOW>;

            port {
                panel_in: endpoint {
                    remote-endpoint = <&dsi0_out>;
                };
            };
        };
    };

...
```

## Documentation/devicetree/bindings/extcon/maxim,max77849.yaml
```yaml
# SPDX-License-Identifier: (GPL-2.0-only OR BSD-2-Clause)
%YAML 1.2
---
$id: http://devicetree.org/schemas/extcon/maxim,max77849.yaml#
$schema: http://devicetree.org/meta-schemas/core.yaml#

title: Maxim MAX77849 Micro-USB Interface Controller

maintainers:
  - Sean Hoyt <seanhoyt963@gmail.com>

description: |
  The MAX77849 MUIC detects USB host cables and BC1.2 charger types, switches
  the USB data path, and coordinates the charger boost converter for USB OTG.
  It is a child of the MAX77849 MFD because the MUIC has a separate I2C address
  while sharing charger mode control with the parent PMIC.

properties:
  compatible:
    const: maxim,max77849-muic

  maxim,charger:
    $ref: /schemas/types.yaml#/definitions/phandle
    description:
      MAX77849 charger power supply that receives detected USB source types.

  maxim,poll-interval-ms:
    description:
      Cable detection interval. Polling allows operation on boards whose
      shared MAX77849 interrupt is unavailable.
    minimum: 250
    maximum: 60000
    default: 1000

  connector:
    $ref: /schemas/connector/usb-connector.yaml#
    unevaluatedProperties: false

required:
  - compatible
  - maxim,charger
  - connector

additionalProperties: false
...
```

## Documentation/devicetree/bindings/leds/backlight/richtek,rt8555.yaml
```yaml
# SPDX-License-Identifier: (GPL-2.0-only OR BSD-2-Clause)
%YAML 1.2
---
$id: http://devicetree.org/schemas/leds/backlight/richtek,rt8555.yaml#
$schema: http://devicetree.org/meta-schemas/core.yaml#

title: Richtek RT8555 6-channel WLED backlight driver

maintainers:
  - postmarketOS Kernel maintainers <kernel@postmarketos.org>

description: |
  The RT8555 is a 6-channel current-mode boost converter for white LED
  backlights. It supports an I2C-programmable 10-bit brightness level and up
  to 35 mA per LED string.

  https://www.richtek.com/assets/product_file/RT8555/DS8555-01.pdf

allOf:
  - $ref: common.yaml#

properties:
  compatible:
    const: richtek,rt8555

  reg:
    maxItems: 1

  enable-gpios:
    description:
      GPIO connected to the active-high EN pin. May be omitted when EN is
      tied high.
    maxItems: 1

  max-brightness:
    minimum: 1
    maximum: 1023
    default: 1023

  default-brightness:
    maximum: 1023

  richtek,led-current-microamp:
    description:
      Maximum current for each enabled LED current sink. Values are rounded
      to the nearest supported hardware step.
    minimum: 10020
    maximum: 35000
    default: 20040

  richtek,led-driver-headroom-microvolt:
    description: Voltage headroom maintained across each LED current sink.
    enum: [ 500000, 570000, 600000, 700000 ]
    default: 500000

required:
  - compatible
  - reg

unevaluatedProperties: false

examples:
  - |
    #include <dt-bindings/gpio/gpio.h>

    i2c {
        #address-cells = <1>;
        #size-cells = <0>;

        backlight@31 {
            compatible = "richtek,rt8555";
            reg = <0x31>;
            enable-gpios = <&gpio 69 GPIO_ACTIVE_HIGH>;

            default-brightness = <511>;
            richtek,led-current-microamp = <25000>;
            richtek,led-driver-headroom-microvolt = <570000>;
        };
    };
...
```

## Documentation/devicetree/bindings/leds/kinetic,ktd2692.yaml
```yaml
# SPDX-License-Identifier: (GPL-2.0-only OR BSD-2-Clause)
%YAML 1.2
---
$id: http://devicetree.org/schemas/leds/kinetic,ktd2692.yaml#
$schema: http://devicetree.org/meta-schemas/core.yaml#

title: KTD2692 Flash LED Driver from Kinetic Technologies

maintainers:
  - Markuss Broks <markuss.broks@gmail.com>

description: |
  KTD2692 is the ideal power solution for high-power flash LEDs.
  It uses ExpressWire single-wire programming for maximum flexibility.

  The ExpressWire interface through CTRL pin can control LED on/off and
  enable/disable the IC, Movie(max 1/3 of Flash current) / Flash mode current,
  Flash timeout, LVP(low voltage protection).

  Also, When the AUX pin is pulled high while CTRL pin is high,
  LED current will be ramped up to the flash-mode current level.

properties:
  compatible:
    const: kinetic,ktd2692

  ctrl-gpios:
    maxItems: 1
    description: Specifier of the GPIO connected to CTRL pin.

  aux-gpios:
    maxItems: 1
    description: Specifier of the GPIO connected to CTRL pin.

  vin-supply:
    description: LED supply (2.7V to 5.5V).

  led:
    type: object
    $ref: common.yaml#
    description: Properties for the LED.
    properties:
      function: true
      color: true
      flash-max-timeout-us:
        minimum: 262000
        maximum: 1835000
        description: Flash LED maximum timeout.

      led-max-microamp:
        minimum: 1
        maximum: 500000
        description: |
          Maximum movie (torch) current. The movie current cannot exceed one
          third of the maximum flash current.

      flash-max-microamp:
        minimum: 48
        maximum: 1500000
        description: |
          Flash LED maximum current. The maximum is set by the external RSET
          resistor according to I(uA) = 15000000 / Rset(kOhm).

    additionalProperties: false

required:
  - compatible
  - ctrl-gpios
  - led

additionalProperties: false

examples:
  - |
    #include <dt-bindings/gpio/gpio.h>
    #include <dt-bindings/leds/common.h>

    ktd2692 {
      compatible = "kinetic,ktd2692";
      ctrl-gpios = <&gpc0 1 0>;
      aux-gpios = <&gpc0 2 0>;
      vin-supply = <&vbat>;

      led {
        function = LED_FUNCTION_FLASH;
        color = <LED_COLOR_ID_WHITE>;
        flash-max-timeout-us = <262000>;
        flash-max-microamp = <150000>;
        led-max-microamp = <25000>;
      };
    };

...
```

## Documentation/devicetree/bindings/media/i2c/dongwoon,dw9714.yaml
```yaml
# SPDX-License-Identifier: GPL-2.0-only OR BSD-2-Clause
%YAML 1.2
---
$id: http://devicetree.org/schemas/media/i2c/dongwoon,dw9714.yaml#
$schema: http://devicetree.org/meta-schemas/core.yaml#

title: Dongwoon Anatech DW9714 and DW9804 camera voice coil lens drivers

maintainers:
  - Krzysztof Kozlowski <krzk@kernel.org>

description:
  DW9714 and DW9804 are 10-bit DACs with current sink capability. They are
  intended for driving voice coil lenses in camera modules.

properties:
  compatible:
    enum:
      - dongwoon,dw9714
      - dongwoon,dw9804

  reg:
    maxItems: 1

  powerdown-gpios:
    description:
      XSD pin for shutdown (active low)

  vcc-supply:
    description: VDD power supply

  iovdd-supply:
    description: Optional supply for the I2C bus pull-ups

required:
  - compatible
  - reg

additionalProperties: false

examples:
  - |
    i2c {
        #address-cells = <1>;
        #size-cells = <0>;

        camera-lens@c {
            compatible = "dongwoon,dw9714";
            reg = <0x0c>;
            vcc-supply = <&reg_csi_1v8>;
        };
    };
```

## Documentation/devicetree/bindings/media/i2c/samsung,s5k4ecgx.yaml
```yaml
# SPDX-License-Identifier: (GPL-2.0-only OR BSD-2-Clause)
%YAML 1.2
---
$id: http://devicetree.org/schemas/media/i2c/samsung,s5k4ecgx.yaml#
$schema: http://devicetree.org/meta-schemas/core.yaml#

title: Samsung S5K4ECGX image sensor

maintainers:
  - Sean Hoyt <seanhoyt963@gmail.com>

description:
  The Samsung S5K4ECGX is a 5-megapixel CMOS image sensor with an integrated
  image signal processor and autofocus engine. It is controlled over I2C and
  transmits processed YUV 4:2:2 data over a two-lane MIPI CSI-2 interface.

allOf:
  - $ref: /schemas/media/video-interface-devices.yaml#

properties:
  compatible:
    const: samsung,s5k4ecgx

  reg:
    const: 0x56

  clocks:
    maxItems: 1

  clock-names:
    const: xclk

  reset-gpios:
    maxItems: 1

  standby-gpios:
    maxItems: 1

  vana-supply:
    description: Analog supply

  vdig-supply:
    description: Digital core supply

  vio-supply:
    description: Digital I/O supply

  vaf-supply:
    description: Autofocus supply

  orientation: true

  rotation: true

  port:
    $ref: /schemas/graph.yaml#/$defs/port-base
    additionalProperties: false

    properties:
      endpoint:
        $ref: /schemas/media/video-interfaces.yaml#
        unevaluatedProperties: false

        properties:
          data-lanes:
            minItems: 2
            maxItems: 2

          link-frequencies:
            maxItems: 1

        required:
          - data-lanes
          - link-frequencies

    required:
      - endpoint

required:
  - compatible
  - reg
  - clocks
  - clock-names
  - reset-gpios
  - standby-gpios
  - vana-supply
  - vdig-supply
  - vio-supply
  - vaf-supply
  - port

additionalProperties: false

examples:
  - |
    #include <dt-bindings/gpio/gpio.h>

    i2c {
        #address-cells = <1>;
        #size-cells = <0>;

        camera@56 {
            compatible = "samsung,s5k4ecgx";
            reg = <0x56>;

            clocks = <&camera_clk>;
            clock-names = "xclk";

            reset-gpios = <&gpio 35 GPIO_ACTIVE_HIGH>;
            standby-gpios = <&gpio 34 GPIO_ACTIVE_HIGH>;

            vana-supply = <&camera_vana>;
            vdig-supply = <&camera_vdig>;
            vio-supply = <&camera_vio>;
            vaf-supply = <&camera_vaf>;

            port {
                endpoint {
                    data-lanes = <1 2>;
                    link-frequencies = /bits/ 64 <144000000>;
                    remote-endpoint = <&csi_in>;
                };
            };
        };
    };
...
```

## Documentation/devicetree/bindings/media/i2c/siliconfile,sr200pc20.yaml
```yaml
# SPDX-License-Identifier: (GPL-2.0-only OR BSD-2-Clause)
%YAML 1.2
---
$id: http://devicetree.org/schemas/media/i2c/siliconfile,sr200pc20.yaml#
$schema: http://devicetree.org/meta-schemas/core.yaml#

title: SiliconFile SR200PC20 image sensor

maintainers:
  - Sean Hoyt <seanhoyt963@gmail.com>

description:
  The SiliconFile SR200PC20 is a 2-megapixel CMOS image sensor with an
  integrated image signal processor. It is controlled over I2C and transmits
  YUV 4:2:2 image data over a single-lane MIPI CSI-2 interface.

allOf:
  - $ref: /schemas/media/video-interface-devices.yaml#

properties:
  compatible:
    const: siliconfile,sr200pc20

  reg:
    const: 0x20

  clocks:
    maxItems: 1

  clock-names:
    const: xclk

  reset-gpios:
    maxItems: 1

  standby-gpios:
    maxItems: 1

  vana-supply:
    description: Analog supply

  vdig-supply:
    description: Digital core supply

  vio-supply:
    description: Digital I/O supply

  orientation: true

  rotation: true

  port:
    $ref: /schemas/graph.yaml#/$defs/port-base
    additionalProperties: false

    properties:
      endpoint:
        $ref: /schemas/media/video-interfaces.yaml#
        unevaluatedProperties: false

        properties:
          data-lanes:
            maxItems: 1

          link-frequencies:
            description:
              The normal preview frequency is required. The recording-mode
              frequency is optional for modules that support that tuning.
            minItems: 1
            maxItems: 2
            items:
              - const: 144000000
              - const: 180000000

        required:
          - data-lanes
          - link-frequencies

    required:
      - endpoint

required:
  - compatible
  - reg
  - clocks
  - clock-names
  - reset-gpios
  - standby-gpios
  - vana-supply
  - vdig-supply
  - vio-supply
  - port

additionalProperties: false

examples:
  - |
    #include <dt-bindings/gpio/gpio.h>

    i2c {
        #address-cells = <1>;
        #size-cells = <0>;

        camera@20 {
            compatible = "siliconfile,sr200pc20";
            reg = <0x20>;

            clocks = <&camera_clk>;
            clock-names = "xclk";

            reset-gpios = <&gpio 28 GPIO_ACTIVE_HIGH>;
            standby-gpios = <&gpio 32 GPIO_ACTIVE_HIGH>;

            vana-supply = <&camera_vana>;
            vdig-supply = <&camera_vdig>;
            vio-supply = <&camera_vio>;

            port {
                endpoint {
                    data-lanes = <1>;
                    link-frequencies = /bits/ 64 <144000000 180000000>;
                    remote-endpoint = <&csi_in>;
                };
            };
        };
    };
...
```
