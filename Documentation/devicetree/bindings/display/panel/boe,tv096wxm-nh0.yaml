## Documentation/devicetree/bindings/media/i2c/siliconfile,sr544.yaml
```yaml
# SPDX-License-Identifier: (GPL-2.0-only OR BSD-2-Clause)
%YAML 1.2
---
$id: http://devicetree.org/schemas/media/i2c/siliconfile,sr544.yaml#
$schema: http://devicetree.org/meta-schemas/core.yaml#

title: SiliconFile SR544 image sensor

maintainers:
  - Sean Hoyt <seanhoyt963@gmail.com>

description:
  The SiliconFile SR544 is a 5-megapixel CMOS image sensor. It is controlled
  over I2C and transmits 10-bit raw Bayer image data over a two-lane MIPI
  CSI-2 interface.

allOf:
  - $ref: /schemas/media/video-interface-devices.yaml#

properties:
  compatible:
    const: siliconfile,sr544

  reg:
    const: 0x28

  clocks:
    maxItems: 1

  clock-names:
    const: xclk

  reset-gpios:
    maxItems: 1

  standby-gpios:
    maxItems: 1

  vana-supply:
    description: Analog supply

  vdig-supply:
    description: Digital core supply

  vio-supply:
    description: Digital I/O supply

  orientation: true

  rotation: true

  port:
    $ref: /schemas/graph.yaml#/$defs/port-base
    additionalProperties: false

    properties:
      endpoint:
        $ref: /schemas/media/video-interfaces.yaml#
        unevaluatedProperties: false

        properties:
          data-lanes:
            minItems: 2
            maxItems: 2

          link-frequencies:
            maxItems: 1

        required:
          - data-lanes
          - link-frequencies

    required:
      - endpoint

required:
  - compatible
  - reg
  - clocks
  - clock-names
  - reset-gpios
  - standby-gpios
  - vana-supply
  - vdig-supply
  - vio-supply
  - port

additionalProperties: false

examples:
  - |
    #include <dt-bindings/gpio/gpio.h>

    i2c {
        #address-cells = <1>;
        #size-cells = <0>;

        camera@28 {
            compatible = "siliconfile,sr544";
            reg = <0x28>;

            clocks = <&camera_clk>;
            clock-names = "xclk";

            reset-gpios = <&gpio 35 GPIO_ACTIVE_HIGH>;
            standby-gpios = <&gpio 34 GPIO_ACTIVE_HIGH>;

            vana-supply = <&camera_vana>;
            vdig-supply = <&camera_vdig>;
            vio-supply = <&camera_vio>;

            port {
                endpoint {
                    data-lanes = <1 2>;
                    link-frequencies = /bits/ 64 <440000000>;
                    remote-endpoint = <&csi_in>;
                };
            };
        };
    };
...
```

## Documentation/devicetree/bindings/mfd/maxim,max77849.yaml
```yaml
# SPDX-License-Identifier: (GPL-2.0-only OR BSD-2-Clause)
%YAML 1.2
---
$id: http://devicetree.org/schemas/mfd/maxim,max77849.yaml#
$schema: http://devicetree.org/meta-schemas/core.yaml#

title: Maxim MAX77849 Companion Power Management IC

maintainers:
  - Sean Hoyt <seanhoyt963@gmail.com>

description: |
  The MAX77849 is a companion PMIC containing a single-cell Li-ion charger,
  system power path, safeout regulators, flash LED control, and a Micro-USB
  Interface Controller (MUIC). The PMIC/charger register bank is at I2C
  address 0x66; the MUIC uses a separate I2C address.

properties:
  compatible:
    const: maxim,max77849

  reg:
    maxItems: 1

  interrupts:
    maxItems: 1

  wakeup-source: true

  charger:
    $ref: /schemas/power/supply/maxim,max77849-charger.yaml#

  extcon:
    $ref: /schemas/extcon/maxim,max77849.yaml#

required:
  - compatible
  - reg
  - charger
  - extcon

additionalProperties: false

examples:
  - |
    i2c {
        #address-cells = <1>;
        #size-cells = <0>;

        pmic@66 {
            compatible = "maxim,max77849";
            reg = <0x66>;

            charger: charger {
                compatible = "maxim,max77849-charger";
                monitored-battery = <&battery>;
                maxim,monitored-fuel-gauge = <&fuel_gauge>;
                maxim,input-current-limit-microamp = <460000>;
                maxim,input-current-limit-max-microamp = <1800000>;
                maxim,charge-current-limit-microamp = <520000>;
                maxim,cdp-input-current-limit-microamp = <1000000>;
                maxim,cdp-charge-current-limit-microamp = <1000000>;
                maxim,dcp-input-current-limit-microamp = <1800000>;
                maxim,dcp-charge-current-limit-microamp = <2200000>;
            };

            extcon {
                compatible = "maxim,max77849-muic";
                maxim,charger = <&charger>;

                connector {
                    compatible = "usb-b-connector";
                    label = "micro-USB";
                    type = "micro";
                };
            };
        };
    };
...
```

## Documentation/devicetree/bindings/mfd/siliconmitus,sm5703.yaml
```yaml
# SPDX-License-Identifier: (GPL-2.0-only OR BSD-2-Clause)
%YAML 1.2
---
$id: http://devicetree.org/schemas/mfd/siliconmitus,sm5703.yaml#
$schema: http://devicetree.org/meta-schemas/core.yaml#

title: Silicon Mitus SM5703 Multi-Function Device

maintainers:
  - Sean Hoyt <seanhoyt963@gmail.com>

description: |
  The SM5703 is a companion power-management IC containing a battery charger,
  an OTG boost converter, regulators and a flash LED controller. Its MUIC and
  fuel gauge are independent I2C devices and are described separately.

properties:
  compatible:
    const: siliconmitus,sm5703

  reg:
    maxItems: 1

  interrupts:
    maxItems: 1

  reset-gpios:
    maxItems: 1
    description:
      Active-low master reset input.

  wakeup-source: true

  regulators:
    $ref: /schemas/regulator/siliconmitus,sm5703-regulator.yaml#

  charger:
    $ref: /schemas/power/supply/siliconmitus,sm5703-charger.yaml#
    unevaluatedProperties: false

required:
  - compatible
  - reg
  - interrupts

additionalProperties: false

examples:
  - |
    #include <dt-bindings/gpio/gpio.h>
    #include <dt-bindings/interrupt-controller/irq.h>

    i2c {
        #address-cells = <1>;
        #size-cells = <0>;

        pmic@49 {
            compatible = "siliconmitus,sm5703";
            reg = <0x49>;
            interrupt-parent = <&tlmm>;
            interrupts = <1 IRQ_TYPE_EDGE_FALLING>;
            reset-gpios = <&tlmm 36 GPIO_ACTIVE_LOW>;

            regulators {
                vbus {
                    regulator-name = "usb_vbus";
                    regulator-min-microvolt = <5000000>;
                    regulator-max-microvolt = <5000000>;
                };
            };
        };
    };
...
```

## Documentation/devicetree/bindings/power/supply/maxim,max77849-charger.yaml
```yaml
# SPDX-License-Identifier: (GPL-2.0-only OR BSD-2-Clause)
%YAML 1.2
---
$id: http://devicetree.org/schemas/power/supply/maxim,max77849-charger.yaml#
$schema: http://devicetree.org/meta-schemas/core.yaml#

title: Maxim MAX77849 Battery Charger

maintainers:
  - Sean Hoyt <seanhoyt963@gmail.com>

description: |
  The MAX77849 contains a programmable single-cell Li-ion charger and power
  path. Battery CC/CV, termination, recharge, and thermal limits are obtained
  from the simple-battery node referenced by monitored-battery. Until a safe
  temperature is available from the fuel gauge, the driver inhibits charging.

allOf:
  - $ref: power-supply.yaml#

properties:
  compatible:
    const: maxim,max77849-charger

  monitored-battery: true

  maxim,monitored-fuel-gauge:
    $ref: /schemas/types.yaml#/definitions/phandle
    description:
      Fuel-gauge power supply used for live battery temperature monitoring.

  maxim,input-current-limit-microamp:
    description:
      Conservative input current limit used before a source is classified.
    minimum: 100000
    maximum: 3175000

  maxim,input-current-limit-max-microamp:
    description:
      Board maximum accepted when userspace or a cable detector raises the
      input current limit.
    minimum: 100000
    maximum: 3175000

  maxim,charge-current-limit-microamp:
    description:
      Conservative fast-charge current used before a source is classified.
    minimum: 40000
    maximum: 2520000

  maxim,cdp-input-current-limit-microamp:
    description: Input current limit for a BC1.2 charging downstream port.
    minimum: 100000
    maximum: 3175000

  maxim,cdp-charge-current-limit-microamp:
    description: Fast-charge current for a BC1.2 charging downstream port.
    minimum: 40000
    maximum: 2520000

  maxim,dcp-input-current-limit-microamp:
    description: Input current limit for a BC1.2 dedicated charging port.
    minimum: 100000
    maximum: 3175000

  maxim,dcp-charge-current-limit-microamp:
    description: Fast-charge current for a BC1.2 dedicated charging port.
    minimum: 40000
    maximum: 2520000

  maxim,otg-current-limit-microamp:
    description: Output current limit while sourcing VBUS in USB host mode.
    enum: [500000, 1200000]
    default: 500000

  maxim,min-system-microvolt:
    description: Minimum system regulation voltage.
    enum: [3000000, 3100000, 3200000, 3300000, 3400000, 3500000,
           3600000, 3700000]
    default: 3600000

  maxim,fast-charge-timer-hours:
    $ref: /schemas/types.yaml#/definitions/uint32
    description:
      Hardware fast-charge safety timer duration. Zero disables the timer.
    enum: [0, 4, 6, 8, 10, 12, 14, 16]
    default: 16

  maxim,topoff-timer-minutes:
    $ref: /schemas/types.yaml#/definitions/uint32
    description: Hardware top-off timer duration.
    enum: [0, 10, 20, 30, 40, 50, 60, 70]
    default: 70

  maxim,poll-interval-ms:
    description:
      Interval for status and fuel-gauge temperature monitoring.
    minimum: 1000
    maximum: 60000
    default: 5000

required:
  - compatible
  - monitored-battery
  - maxim,monitored-fuel-gauge
  - maxim,input-current-limit-microamp
  - maxim,input-current-limit-max-microamp
  - maxim,charge-current-limit-microamp
  - maxim,cdp-input-current-limit-microamp
  - maxim,cdp-charge-current-limit-microamp
  - maxim,dcp-input-current-limit-microamp
  - maxim,dcp-charge-current-limit-microamp

unevaluatedProperties: false
...
```

## Documentation/devicetree/bindings/power/supply/siliconmitus,sm5703-charger.yaml
```yaml
# SPDX-License-Identifier: (GPL-2.0-only OR BSD-2-Clause)
%YAML 1.2
---
$id: http://devicetree.org/schemas/power/supply/siliconmitus,sm5703-charger.yaml#
$schema: http://devicetree.org/meta-schemas/core.yaml#

title: Silicon Mitus SM5703 Battery Charger

maintainers:
  - Sean Hoyt <seanhoyt963@gmail.com>

description:
  The charger is a child of the SM5703 multi-function device. Cable type is
  supplied by an SM5502-compatible MUIC through the extcon subsystem.

properties:
  compatible:
    const: siliconmitus,sm5703-charger

  monitored-battery: true

  siliconmitus,monitored-fuel-gauge:
    $ref: /schemas/types.yaml#/definitions/phandle
    description:
      Fuel gauge supplying the live battery temperature used to inhibit
      charging outside the monitored battery's temperature limits.

  siliconmitus,usb-connector:
    $ref: /schemas/types.yaml#/definitions/phandle
    description:
      Phandle to the USB connector child of the SM5703 MUIC node.

  enable-gpios:
    maxItems: 1
    description:
      Active-low nCHGEN hardware charger-enable input.

  input-current-limit-microamp:
    minimum: 100000
    maximum: 2100000
    multipleOf: 50000
    default: 1000000
    description:
      Maximum input current used for a dedicated charging port. SDP and CDP
      limits are selected from the USB-defined limits.

  input-voltage-limit-microvolt:
    minimum: 4300000
    maximum: 4900000
    multipleOf: 100000
    default: 4300000
    description:
      Automatic input-current-limit voltage threshold.

  siliconmitus,topoff-timer-minutes:
    $ref: /schemas/types.yaml#/definitions/uint32
    description: Top-off safety timer duration.
    enum: [10, 20, 30, 45]
    default: 45

  siliconmitus,boost-iq3-limit-1x:
    type: boolean
    description:
      Select the full boost-converter IQ3 current limit instead of 0.7 times
      the nominal limit.

  siliconmitus,poll-interval-ms:
    minimum: 1000
    maximum: 60000
    default: 10000
    description:
      Interval between battery-temperature safety checks.

required:
  - compatible
  - monitored-battery
  - siliconmitus,monitored-fuel-gauge
  - siliconmitus,usb-connector

allOf:
  - $ref: power-supply.yaml#

additionalProperties: false

examples:
  - |
    #include <dt-bindings/gpio/gpio.h>

    charger {
        compatible = "siliconmitus,sm5703-charger";
        monitored-battery = <&battery>;
        siliconmitus,monitored-fuel-gauge = <&fuel_gauge>;
        siliconmitus,usb-connector = <&usb_con>;
        enable-gpios = <&tlmm 119 GPIO_ACTIVE_LOW>;
        input-current-limit-microamp = <1000000>;
        input-voltage-limit-microvolt = <4300000>;
        siliconmitus,topoff-timer-minutes = <45>;
        siliconmitus,boost-iq3-limit-1x;
    };
...
```
